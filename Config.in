## configs/zerow_defconfig
```kconfig
BR2_TARGET_GENERIC_HOSTNAME="zero_w"
BR2_TARGET_GENERIC_ISSUE="Welcome to the zero_w board"

# board/compiler target setup
BR2_aarch64=y
BR2_cortex_a53=y

# post build sdcard image generaton
BR2_ROOTFS_POST_BUILD_SCRIPT="$(BR2_EXTERNAL)/board/S905Y2/post-build.sh"
#BR2_ROOTFS_POST_IMAGE_SCRIPT="$(BR2_EXTERNAL)/board/S905Y2/post-image.sh"

# Filesystems
BR2_TARGET_ROOTFS_EXT2=y
BR2_TARGET_ROOTFS_EXT2_4=y
BR2_TARGET_ROOTFS_EXT2_SIZE="250M"
BR2_PACKAGE_HOST_DOSFSTOOLS=y
BR2_PACKAGE_HOST_MTOOLS=y
BR2_PACKAGE_HOST_UBOOT_TOOLS=y
BR2_PACKAGE_HOST_GENIMAGE=y

# u-boot
BR2_TARGET_UBOOT=y
BR2_TARGET_UBOOT_BUILD_SYSTEM_KCONFIG=y
BR2_TARGET_UBOOT_USE_DEFCONFIG=y
BR2_TARGET_UBOOT_CUSTOM_GIT=y
BR2_TARGET_UBOOT_CUSTOM_REPO_URL="https://github.com/radxa/u-boot.git"
BR2_TARGET_UBOOT_CUSTOM_REPO_VERSION="radxa-zero-v2021.07"
BR2_TARGET_UBOOT_BOARD_DEFCONFIG="radxa-zero2"
BR2_TARGET_UBOOT_CONFIG_FRAGMENT_FILES="$(BR2_EXTERNAL)/board/S905Y2/uboot.fragment"

# linux
BR2_LINUX_KERNEL=y
BR2_LINUX_KERNEL_LATEST_VERSION=y
BR2_LINUX_KERNEL_DEFCONFIG="defconfig"
BR2_KERNEL_HEADERS_AS_KERNEL=y

BR2_LINUX_KERNEL_INTREE_DTS_NAME="meson-g12a-radxa-zero"
BR2_LINUX_KERNEL_DTS_SUPPORT=y
BR2_LINUX_KERNEL_IMAGE=y
BR2_LINUX_KERNEL_GZIP=y
BR2_LINUX_KERNEL_DTB_OVERLAY_SUPPORT=y

# configure the place to source patches, the busybox frament, overlays
BR2_ROOTFS_OVERLAY="$(BR2_EXTERNAL)/overlays"

# where to store downloads
BR2_DL_DIR="$(BASE_DIR)/../../buildroot.dl"

# This package is fundamental in order to the uboot properly installed
BR2_PACKAGE_FIP=y

# external packages
BR2_PACKAGE_NTP=y
BR2_PACKAGE_NTP_NTPDATE=y

BR2_PACKAGE_OPENSSH=y
BR2_PACKAGE_OPENSSH_SERVER=y
BR2_PACKAGE_OPENSSH_CLIENT=y
BR2_SYSTEM_DHCP="eth0"
BR2_PACKAGE_AVAHI=y
BR2_PACKAGE_AVAHI_DAEMON=y
BR2_PACKAGE_MDNS=y
```

## package/Config.in
```kconfig
menu "Packages"
	source "$BR2_EXTERNAL_CUSTOM_AUDIO_INJECTOR_PATH/package/libsox/Config.in"
	source "$BR2_EXTERNAL_CUSTOM_AUDIO_INJECTOR_PATH/package/fip/Config.in"
endmenu
```

## package/fip/Config.in
```kconfig
config BR2_PACKAGE_FIP
        bool "fip"
	select BR2_PACKAGE_UBOOT
        help
		Amlogic Firmware In Package - Prebuilt binaries/tools to pack Amlogic bootloader package

       		https://github.com/radxa/fip

comment "This package needs uboot!"
	depends on !BR2_PACKAGE_UBOOT
```
